## fedora/dts/bindings/pci/allwinner,sun60i-a733-cubie-a7a-pcie.yaml
```yaml
# SPDX-License-Identifier: (GPL-2.0-only OR BSD-2-Clause)
%YAML 1.2
---
$id: http://devicetree.org/schemas/pci/allwinner,sun60i-a733-cubie-a7a-pcie.yaml#
$schema: http://devicetree.org/meta-schemas/core.yaml#
title: Cubie A7A native A733 PCIe host
maintainers:
  - DaveWK <13626476+DaveWK@users.noreply.github.com>
allOf:
  - $ref: /schemas/pci/snps,dw-pcie.yaml#
properties:
  compatible:
    const: allwinner,sun60i-a733-cubie-a7a-pcie
  reg:
    maxItems: 4
  reg-names:
    items:
      - const: dbi
      - const: config
      - const: atu
      - const: app
  clocks:
    maxItems: 3
  clock-names:
    items:
      - const: aux
      - const: slv
      - const: mstr
  resets:
    maxItems: 3
  reset-names:
    items:
      - const: app
      - const: pwr
      - const: core
  phys:
    maxItems: 1
  phy-names:
    const: pcie-phy
  power-domains:
    maxItems: 1
  pcie1v8-supply:
    description: BLDO1 PCIe 1.8V supply.
  pcie3v3-supply:
    description: DCDC1 PCIe 3.3V supply.
  power-gpios:
    maxItems: 1
    description: PE11 endpoint power enable, active high.
  reset-gpios:
    maxItems: 1
    description: PE13 endpoint PERST, active low.
  wake-gpios:
    maxItems: 1
    description: PE12 endpoint WAKE input, active low. PME support is pending.
  num-lanes:
    const: 1
  max-link-speed:
    const: 3
  interrupts:
    maxItems: 2
  interrupt-names:
    items:
      - const: app
      - const: msi
  legacy-interrupt-controller:
    type: object
    properties:
      interrupt-controller: true
      "#interrupt-cells":
        const: 1
      "#address-cells":
        const: 0
    required:
      - interrupt-controller
      - "#interrupt-cells"
      - "#address-cells"
    additionalProperties: false
required:
  - compatible
  - reg
  - reg-names
  - clocks
  - clock-names
  - resets
  - reset-names
  - phys
  - phy-names
  - power-domains
  - pcie1v8-supply
  - pcie3v3-supply
  - power-gpios
  - reset-gpios
  - wake-gpios
  - interrupts
  - interrupt-names
  - interrupt-map
  - interrupt-map-mask
  - legacy-interrupt-controller
unevaluatedProperties: false
```

## fedora/dts/bindings/phy/allwinner,sun60i-a733-cubie-a7a-serdes.yaml
```yaml
# SPDX-License-Identifier: (GPL-2.0-only OR BSD-2-Clause)
%YAML 1.2
---
$id: http://devicetree.org/schemas/phy/allwinner,sun60i-a733-cubie-a7a-serdes.yaml#
$schema: http://devicetree.org/meta-schemas/core.yaml#
title: Cubie A7A fixed paired USB3 and PCIe SERDES
maintainers:
  - DaveWK <13626476+DaveWK@users.noreply.github.com>
description: |
  Board-local native resource owner for fixed combo0 USB host and combo1 PCIe.
  The DWC3 child is populated only after the common bus is ready. One PHY
  argument selects PHY_TYPE_USB2, PHY_TYPE_USB3 or PHY_TYPE_PCIE; no DP or
  Type-C switching. The USB2 analog block and common resistance calibration
  have the same serialized owner. USB2 init runs after the DWC3 clocks start.
properties:
  compatible:
    const: allwinner,sun60i-a733-cubie-a7a-serdes
  reg:
    maxItems: 8
  reg-names:
    items:
      - const: subsys
      - const: map
      - const: combo0-top
      - const: combo0-phy
      - const: combo1-top
      - const: combo1-phy
      - const: usb2-phy
      - const: rescal
  clocks:
    maxItems: 6
  clock-names:
    items:
      - const: bus
      - const: mbus
      - const: cfg
      - const: ref0
      - const: ref1
      - const: rescal
  resets:
    maxItems: 1
  reset-names:
    const: serdes
  serdes1v8-supply:
    description: CLDO5 fixed 1.8V SERDES supply.
  power-domains:
    maxItems: 1
  "#phy-cells":
    const: 1
  "#address-cells":
    const: 1
  "#size-cells":
    const: 1
  ranges: true
patternProperties:
  "^usb@[0-9a-f]+$":
    $ref: /schemas/usb/snps,dwc3.yaml#
required:
  - compatible
  - reg
  - reg-names
  - clocks
  - clock-names
  - resets
  - reset-names
  - serdes1v8-supply
  - power-domains
  - "#phy-cells"
  - "#address-cells"
  - "#size-cells"
  - ranges
additionalProperties: false
```
